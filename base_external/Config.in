## base_external/Config.in
```kconfig
source "$BR2_EXTERNAL_BRTEMPLATE_PATH/package/hello-world/Config.in"
source "$BR2_EXTERNAL_BRTEMPLATE_PATH/package/qt-calculator/Config.in"
```

## base_external/package/qt-calculator/Config.in
```kconfig
config BR2_PACKAGE_QT_CALCULATOR
	bool "Qt game package"
	depends on BR2_PACKAGE_QT5
	select BR2_PACKAGE_QT5BASE_WIDGETS
	help
	  Qt game package
```
